## firmware/main/Kconfig.projbuild
```kconfig
menu "XIAO Audio Analyzer"

    config WIFI_SSID
        string "Wi-Fi SSID"
        default "myssid"
        help
            SSID of the Wi-Fi network the analyzer joins on boot.

    config WIFI_PASSWORD
        string "Wi-Fi password"
        default "mypassword"
        help
            WPA/WPA2 PSK for the configured SSID. Leave blank for open networks.

    config WIFI_MAX_RETRY
        int "Wi-Fi connect retry limit"
        default 8
        help
            How many times to retry association before going to soft-AP fallback
            (fallback is reserved for a future revision; today we just keep
            retrying).

    config AUDIO_SAMPLE_RATE_HZ
        int "Audio sample rate (Hz)"
        default 16000
        range 8000 48000
        help
            PDM microphone sample rate. 16 kHz is a good balance of audio
            bandwidth (8 kHz Nyquist) and CPU cost.

    config AUDIO_FFT_SIZE
        int "FFT size (samples, power of 2)"
        default 1024
        range 256 2048
        help
            Length of the analysis window. 1024 @ 16 kHz gives ~15.6 Hz bin
            resolution and ~64 ms hop time.

endmenu
```

## firmware/sdkconfig.defaults
```kconfig
# =============================================================================
# Default project configuration for the XIAO ESP32-S3 Sense audio analyzer.
# Run `idf.py menuconfig` to adjust further; this file seeds reasonable values.
# =============================================================================

# --- Target chip -------------------------------------------------------------
CONFIG_IDF_TARGET="esp32s3"

# --- Partition table ---------------------------------------------------------
# Custom CSV gives us a single 2 MB app slot which is plenty here and leaves
# headroom for OTA / SPIFFS in the future.
CONFIG_PARTITION_TABLE_CUSTOM=y
CONFIG_PARTITION_TABLE_CUSTOM_FILENAME="partitions.csv"
CONFIG_PARTITION_TABLE_FILENAME="partitions.csv"

# --- PSRAM (Octal SPI on the XIAO ESP32-S3 Sense, 8 MB) ----------------------
CONFIG_SPIRAM=y
CONFIG_SPIRAM_MODE_OCT=y
CONFIG_SPIRAM_TYPE_AUTO=y
CONFIG_SPIRAM_SPEED_80M=y
CONFIG_SPIRAM_USE_MALLOC=y
CONFIG_SPIRAM_MALLOC_ALWAYSINTERNAL=16384
CONFIG_SPIRAM_TRY_ALLOCATE_WIFI_LWIP=y

# --- Flash --------------------------------------------------------------------
CONFIG_ESPTOOLPY_FLASHSIZE_8MB=y
CONFIG_ESPTOOLPY_FLASHMODE_QIO=y
CONFIG_ESPTOOLPY_FLASHFREQ_80M=y

# --- HTTP server with WebSocket support --------------------------------------
CONFIG_HTTPD_WS_SUPPORT=y
CONFIG_HTTPD_MAX_REQ_HDR_LEN=2048
CONFIG_HTTPD_MAX_URI_LEN=512

# --- Main task / FreeRTOS ----------------------------------------------------
CONFIG_ESP_MAIN_TASK_STACK_SIZE=8192
CONFIG_FREERTOS_HZ=1000

# --- Logging -----------------------------------------------------------------
CONFIG_LOG_DEFAULT_LEVEL_INFO=y

# --- Compiler ----------------------------------------------------------------
CONFIG_COMPILER_OPTIMIZATION_PERF=y
```
